## Kconfig
```kconfig
config ZMK_BEHAVIOR_SENSOR_ROTATE_DIR_LOCK
    bool "Enable sensor rotate direction lock behavior"
    default n

config ZMK_BEHAVIOR_SENSOR_ROTATE_DIR_LOCK_HOLD_TIME_MS
    int "Direction lock hold time (ms)"
    default 600
    depends on ZMK_BEHAVIOR_SENSOR_ROTATE_DIR_LOCK
```

## config/west.yml
```yaml
manifest:
  remotes:
    - name: zmkfirmware
      url-base: https://github.com/zmkfirmware
    - name: sayu-hub  # pmw3610-driver のフォーク
      url-base: https://github.com/sayu-hub
    - name: Dist16384   # あなたのフォーク
      url-base: https://github.com/Dist16384
    - name: caksoylar  # <-- RGB LED
      url-base: https://github.com/caksoylar  
    - name: pointing-acceleration
      url-base: https://github.com/rain-bbb
    - name: yamaryu211
      url-base: https://github.com/yamaryu211
    - name: mjmjm0101
      url-base: https://github.com/mjmjm0101

  projects:
    - name: zmk
      remote: zmkfirmware
      revision: v0.3
      path: zmk
      import: app/west.yml
    - name: zmk-pmw3610-driver
      remote: Dist16384
      revision: main
      path: modules/zmk-pmw3610-driver
    - name: zmk-rgbled-widget
      remote: caksoylar
      revision: v0.3
    - name: zmk-pointing-acceleration
      remote: pointing-acceleration
      revision: main
    - name: zmk-input-processor-temp-layer-threshold
      remote: yamaryu211
      revision: main
    - name: zmk-input-processor-scroll-inertia
      remote: mjmjm0101
      revision: fix/coasting-weak-input-freeze

  self:
    path: config
```

## dts/bindings/zmk,behavior-sensor-rotate-dir-lock.yaml
```yaml
description: Sensor rotate behavior with direction lock

compatible: "zmk,behavior-sensor-rotate-dir-lock"

properties:
  "#sensor-binding-cells":
    type: int
    required: true
    const: 2
  bindings:
    type: phandles
    required: true
  tap-ms:
    type: int
    default: 5

sensor-binding-cells:
  - param1
  - param2
```

## dts/bindings/zmk,input-processor-scroll-direction-lock.yaml
```yaml
description: Scroll direction lock input processor

compatible: "zmk,input-processor-scroll-direction-lock"

include: [base.yaml]

properties:
  "#input-processor-cells":
    type: int
    const: 0
```

## dts/bindings/zmk,input-processor-scroll-inertia.yaml
```yaml
description: |
  Input processor that adds inertial scrolling to trackball scroll mode.
  Tracks scroll velocity and generates decaying scroll events after the
  trackball stops moving.  Designed for BLE keyboards with integer-only math.

compatible: "zmk,input-processor-scroll-inertia"

properties:
  "#input-processor-cells":
    type: int
    required: true
    const: 0
  track-remainders:
    type: boolean
    description: |
      Required by ZMK input listener framework.
      This processor manages its own remainders internally,
      so this should be left unset (false).

  # ── EMA velocity filter ──────────────────────────────────
  gain:
    type: int
    default: 300
    description: |
      EMA input weight (permille).
      velocity = (delta × gain + velocity × blend) / 1000
  blend:
    type: int
    default: 700
    description: |
      EMA history weight (permille).  gain + blend should equal 1000.

  # ── Inertia start conditions ─────────────────────────────
  start:
    type: int
    default: 75
    description: |
      Minimum EMA velocity (scroll units) to trigger inertia.
  move:
    type: int
    default: 135
    description: |
      Minimum cumulative absolute movement (scroll units) within a
      gesture required to trigger inertia.  Prevents noise-triggered
      activation.
  release:
    type: int
    default: 24
    description: |
      Milliseconds of no input before the trackball is considered
      released.  24 ms ≈ 3 frames at 125 Hz.

  # ── Decay ────────────────────────────────────────────────
  # Defaults give a single iOS-like exponential curve (all rates 990,
  # boundaries at 0).  Set fast/slow > 0 and use different decay rates
  # to enable multi-stage behaviour.
  fast:
    type: int
    default: 0
    description: |
      Velocity boundary (scroll units) between fast and slow decay
      zones.  0 disables the fast zone (single curve mode).
  decay-fast:
    type: int
    default: 990
    description: |
      High-speed decay rate (permille per tick).
      990 = multiply by 0.99 each tick.
  decay-slow:
    type: int
    default: 990
    description: |
      Mid-speed decay rate (permille per tick).
  slow:
    type: int
    default: 0
    description: |
      Velocity boundary (scroll units) between mid and tail decay zones.
      0 disables the tail zone.
  decay-tail:
    type: int
    default: 990
    description: |
      Low-speed tail decay rate (permille per tick).
      Higher value produces a longer, gentler fade-out.
  stop:
    type: int
    default: 7
    description: |
      Velocity (scroll units) below which inertia stops immediately.
      Tune this together with scale/scale-div: lower stop extends the
      tail but produces sparser (jerkier) discrete output near zero.

  # ── Output ───────────────────────────────────────────────
  scale:
    type: int
    default: 1000
    description: |
      Output scale numerator.
      Inertia scroll output = velocity × scale / scale-div per tick.
      When placed before a scaler, match that scaler's ratio.
  scale-div:
    type: int
    default: 1000
    description: |
      Output scale denominator.
  limit:
    type: int
    default: 600
    description: |
      Maximum velocity cap (scroll units).  Prevents runaway scrolling.
  span:
    type: int
    default: 6000
    description: |
      Maximum inertia duration in milliseconds.  Acts as a runaway
      safety cap; natural decay typically terminates earlier.
  tick:
    type: int
    default: 8
    description: |
      Inertia update interval in milliseconds.

  # ── Behaviour ────────────────────────────────────────────
  axis:
    type: int
    default: 0
    description: |
      Which axes receive inertia.  0 = both, 1 = Y only, 2 = X only.
  layer:
    type: int
    default: -1
    description: |
      Scroll layer index.  When >= 0, inertia stops immediately if this
      layer becomes inactive.  -1 = no layer check.
```
